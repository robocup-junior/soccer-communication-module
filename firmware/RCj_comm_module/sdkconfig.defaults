## firmware/RCj_comm_module/sdkconfig.defaults
```kconfig
CONFIG_IDF_TARGET="esp32c6"
CONFIG_IDF_TARGET_ESP32C6=y
CONFIG_FREERTOS_HZ=1000
CONFIG_AUTOSTART_ARDUINO=n
CONFIG_BT_ENABLED=y
CONFIG_BT_NIMBLE_ENABLED=y
CONFIG_BT_CONTROLLER_ENABLED=y
CONFIG_BT_NIMBLE_ROLE_PERIPHERAL=y
CONFIG_BT_NIMBLE_GATT_SERVER=y

# --- Flash size ---
# Legacy ESP32-C6-MINI-1-N4 board = 4 MB flash. (On the C5 master branch this is 8 MB.)
CONFIG_ESPTOOLPY_FLASHSIZE_4MB=y
CONFIG_ESPTOOLPY_FLASHSIZE="4MB"

# --- Released-build UART cleanliness ---
# Robots may read PLAY/STOP from the UART0 line (U3 TX_OUT). Keep that line clean:
# silence bootloader + ESP-IDF + Arduino-HAL logs so only the Arduino Serial output
# ("PLAY"/"STOP") appears. Serial maps to UART0 because ARDUINO_USB_CDC_ON_BOOT is unset
# (do NOT enable it for release). For development logging over USB-C, layer sdkconfig.debug
# on top (see docs/ai/07_build_release_and_flasher.md).
CONFIG_ESP_CONSOLE_UART_DEFAULT=y
CONFIG_BOOTLOADER_LOG_LEVEL_NONE=y
CONFIG_LOG_DEFAULT_LEVEL_NONE=y
CONFIG_ARDUHAL_LOG_DEFAULT_LEVEL_NONE=y
```
